/ {
    kscan0: kscan0 {
        compatible = "zmk,kscan-gpio-matrix";
        diode-direction = "row2col";
        wakeup-source;

        row-gpios
            = <&xiao_d 2 GPIO_ACTIVE_HIGH>
            , <&xiao_d 1 GPIO_ACTIVE_HIGH>
            , <&xiao_d 0 GPIO_ACTIVE_HIGH>
            ;

        col-gpios
            = <&xiao_d 5 (GPIO_ACTIVE_HIGH | GPIO_PULL_DOWN)>
            , <&xiao_d 6 (GPIO_ACTIVE_HIGH | GPIO_PULL_DOWN)>
            ;
    };
};
