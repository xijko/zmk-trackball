## boards/shields/ploopish/Kconfig.shield
```kconfig
# No whitespace after the comma or in your keyboard name!
config SHIELD_MY_KEYBOARD
    def_bool $(shields_list_contains,ploopish)
```

## config/devicetree/bindings/input/gesture-jiggle-processor.yaml
```yaml
# gesture-jiggle-processor.yaml
description: Gesture Jiggle Motion Processor

compatible: "zmk,gesture-jiggle-processor"

include: input-processor.yaml

properties: {}
```

## config/west.yml
```yaml
manifest:
  remotes:
    - name: zmkfirmware
      url-base: https://github.com/zmkfirmware
    - name: george-norton
      url-base: https://github.com/george-norton
    - name: englmaxi
      url-base: https://github.com/englmaxi
  projects:
    - name: zmk
      remote: zmkfirmware
      revision: main
      import: app/west.yml

    - name: zmk-driver-pmw3360
      remote: george-norton
      revision: main

    - name: zmk-hid-trackball-interface
      remote: englmaxi
      revision: main

  self:
    path: config
```
